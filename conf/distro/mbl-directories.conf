## conf/distro/mbl-directories.conf
```bitbake
# Copyright (c) 2018 Arm Limited and Contributors. All rights reserved.
#
# SPDX-License-Identifier: MIT

# See mbl-partitions.conf for directories that are mount points.

# Path to where apps are installed and run from. This path must reside on a r+w partition.
MBL_APP_DIR = "/home/app"
```

## conf/distro/mbl-partitions.conf
```bitbake
# Copyright (c) 2018 Arm Limited and Contributors. All rights reserved.
#
# SPDX-License-Identifier: MIT

# ------------------------------------------------------------------------------
# See docs/partitions.md for information about partition layouts. If you
# change the names or values of these variables then make sure they are still
# compatible with the .wks files in the wic directory and
# recipes-core/base-files/files/fstab.
# ------------------------------------------------------------------------------

MBL_PARTITIONS = "\
    BOOT \
    BOOTFLAGS \
    FACTORY_CONFIG \
    NON_FACTORY_CONFIG \
    LOG \
    SCRATCH \
    HOME \
"

# For each <partition> in MBL_PARTITIONS that should be mounted by default, we
# must define the following variables:
# MBL_<partition>_DIR # Mountpoint for partition
# MBL_<partition>_PARTITION_LABEL # Label of partition

MBL_BOOT_DIR = "/boot"
MBL_BOOT_PARTITION_LABEL = "boot"

MBL_BOOTFLAGS_DIR = "/mnt/flags"
MBL_BOOTFLAGS_PARTITION_LABEL = "bootflags"

MBL_FACTORY_CONFIG_DIR = "/config/factory"
MBL_FACTORY_CONFIG_PARTITION_LABEL = "factory_config"

MBL_NON_FACTORY_CONFIG_DIR = "/config/user"
MBL_NON_FACTORY_CONFIG_PARTITION_LABEL = "nfactory_config1"

MBL_LOG_DIR = "/var/log"
MBL_LOG_PARTITION_LABEL = "log"

MBL_SCRATCH_DIR = "/scratch"
MBL_SCRATCH_PARTITION_LABEL = "scratch"

MBL_HOME_DIR = "/home"
MBL_HOME_PARTITION_LABEL = "home"
```

## conf/distro/mbl.conf
```bitbake
# Copyright (c) 2018 Arm Limited and Contributors. All rights reserved.
#
# SPDX-License-Identifier: MIT

###############################################################################
# mbl.conf
#   This file is the mbed linux OpenEmbedded distribution configuration file.
###############################################################################

require conf/distro/mbl-partitions.conf
require conf/distro/mbl-directories.conf
require conf/distro/mbl-linked-repositories.conf

DISTRO_NAME = "Mbed Linux OS"
DISTRO_VERSION = "0.0"
DISTRO_FEATURES_append = " virtualization"

# Enable build history with installed package size information and image info. 
INHERIT += "buildhistory"
INHERIT += "image-buildinfo"
BUILDHISTORY_COMMIT = "1"

IMAGE_FSTYPES = "ext4 wic.gz wic.bmap tar.xz"

IMAGE_BOOT_FILES += "mbl-bootfiles/*"

# Prevent OE from messing around too much with /var/log - we have a separate
# partition for it
VOLATILE_LOG_DIR = "no"

# Remove x11 related packages for distro images.
DISTRO_FEATURES_DEFAULT_remove = "x11"

# dosfstools is in RRECOMMENDS for packagegroup-base-vfat but it's GPLv3 so we
# don't want it
BAD_RECOMMENDATIONS += "dosfstools"

# readline is GPLv3 so don't include the command line tools for bluez5 that
# depend on readline
PACKAGECONFIG_remove_pn-bluez5 = "readline"

# By default wpa-supplicant uses gnutls as its TLS library, but gnutls depends
# on libunistring which is GPLv3, so tell wpa-supplicant to use openssl instead
# of gnutls.
PACKAGECONFIG_pn-wpa-supplicant = "openssl"
#
# Don't let python add GPLv3 gdbm or readline to RDEPENDS - specify using
# Berkely DB instead of gdbm and just leave out readline support.
PACKAGECONFIG_pn-python3 = "bdb"

#
# Defines root hash suffix.
ROOT_HASH_SUFFIX  = ".root_hash.txt"
#
# Defines signed root hash suffix.
SIGNED_ROOT_HASH_SUFFIX = ".sha256"
#
# Defines base 64 suffix used for the signed root hash
BASE64_SUFFIX = ".base64"
#
# Defines directory for the Verity keys 
VERITY_KEYS_DIR = "${TOPDIR}/../layers/meta-mbl/verity_keys"
#
# Defines rootfs verity public key name
VERITY_ROOTFS_ROOT_HASH_PUBLIC_KEY_NAME="verity_rootfs_root_hash_public.pem"
#
# Defines rootfs verity private key name
VERITY_ROOTFS_ROOT_HASH_PRIVATE_KEY_NAME="verity_rootfs_root_hash_private.pem"
```

## conf/layer.conf
```bitbake
# Copyright (c) 2018 Arm Limited and Contributors. All rights reserved.
#
# SPDX-License-Identifier: MIT

# mbed linux layer configuration file
BBPATH .= ":${LAYERDIR}"

# We have a recipes directory, add to BBFILES
BBFILES += "${LAYERDIR}/recipes*/*/*.bb ${LAYERDIR}/recipes*/*/*.bbappend"

BBFILE_COLLECTIONS += "meta-mbl"
BBFILE_PATTERN_meta-mbl := "^${LAYERDIR}/"
BBFILE_PRIORITY_meta-mbl = "14"
LAYERSERIES_COMPAT_meta-mbl = "sumo thud warrior"

# Make dependent layers compatible with warrior
LAYERSERIES_COMPAT_filesystems-layer_append = " warrior"
LAYERSERIES_COMPAT_networking-layer_append = " warrior"
LAYERSERIES_COMPAT_openembedded-layer_append = " warrior"
LAYERSERIES_COMPAT_meta-python_append = " warrior"
LAYERSERIES_COMPAT_freescale-layer_append = " warrior"
LAYERSERIES_COMPAT_fsl-arm-extra_append = " warrior"
LAYERSERIES_COMPAT_raspberrypi_append = " warrior"
LAYERSERIES_COMPAT_meta-optee_append = " warrior"

# This directory is for storing licenses which are not already included in
# openembedded-core/meta/files/common-licenses
LICENSE_PATH += "${LAYERDIR}/files/custom-licenses"

MBL_LAYER_SCRIPTS = "${LAYERDIR}/scripts"
```

## conf/machine/bananapi-zero.conf
```bitbake
#@TYPE: Machine
#@NAME: bananapi-zero
#@DESCRIPTION: Machine configuration for the bananapi-zero, base on allwinner H2+ CPU

MACHINEOVERRIDES =. "bananapi:bananapi-zero:${MACHINE}:"

require conf/machine/include/sun8i.inc

PREFERRED_PROVIDER_virtual/kernel="linux-mainline"
PREFERRED_VERSION_linux = "linux-bpi"
PREFERRED_PROVIDER_u-boot = "u-boot-bpi"
PREFERRED_PROVIDER_virtual/bootloader = "u-boot-bpi"


KERNEL_DEVICETREE = "sun8i-h2-plus-bananapi-m2-zero.dtb"
KERNEL_IMAGETYPE_bananapi-zero = "zImage"

UBOOT_MACHINE = "bananapi_zero_defconfig"

SPL_BINARY="spl/sunxi-spl.bin"

DEFAULTTUNE = "cortexa7hf-neon-vfpv4"

IMAGE_CLASSES_remove = "sdcard_image-sunxi"

WKS_FILE_bananapi-zero = "mbl-bananapi-zero.wks"

IMAGE_BOOT_FILES_append_bananapi-zero = " kernel.itb"

# backup files for adding signature outside yocoto in future
IMAGE_BOOT_FILES_append_bananapi-zero += " kernel.its"
IMAGE_BOOT_FILES_append_bananapi-zero += " u-boot.its u-boot-nodtb.bin u-boot.dtb boot.its boot.cmd sunxi-spl.bin"

MACHINE_EXTRA_RRECOMMENDS += " linux-firmware-bcm43430 linux-firmware-cyw43430a1 "
MACHINE_FEATURES += " wifi bluetooth"
```

## conf/machine/imx7d-pico-mbl.conf
```bitbake
# Copyright (c) 2018 Arm Limited and Contributors. All rights reserved.
#
# SPDX-License-Identifier: MIT

#@TYPE: Machine
#@NAME: NXP IMX7D PICO-PI Development Board
#@DESCRIPTION: Machine configuration for the PICO PI board

MACHINEOVERRIDES =. "imx7d-pico:${MACHINE}:"
include conf/machine/imx7d-pico.conf

# ------------------------------------------------------------------------------
# non-MBL-specific (upstreamable) configuration
# ------------------------------------------------------------------------------
SERIAL_CONSOLES = "115200;ttymxc4"

# ------------------------------------------------------------------------------
# MBL-specific (non-upstreamable) configuration
# ------------------------------------------------------------------------------

# MBL_DEBUG_INTERFACE variable is used to identify what is the network interface
# that will be used for debugging. For now, this variable is being consumed by
# the systemd-net-conf when generating systemd-net-conf-dbg-iface package.
MBL_DEBUG_INTERFACE = "usb0"

##############################################################################
# KERNEL symbol definitions for virtual/kernel build configuration
#
# KERNEL_CLASSES
#   mbl-fitimage.bbclass is inherited into kernel.bbclass processing by
#   defining this symbol to include mbl-fitimage.
# KERNEL_IMAGETYPE
#   The kernel is packages in a FIT image by specifying "fitImage"
# KERNEL_DEVICETREE
#   Its unnecessary to change this symbol here as the required
#   "imx7s-warp.dtb" value is specified in imx7s-warp.conf (included above)
# KERNEL_MODULE_AUTOLOAD
#   Include the modules loaded at boot time
##############################################################################
KERNEL_CLASSES  = "mbl-fitimage"
KERNEL_DEVICETREE = "imx7d-pico.dtb"
KERNEL_IMAGETYPE = "fitImage"
# When usbgadget feature is present we set the g_ether module to be autoloaded
# during the startup because it will be used as the debug interface.
KERNEL_MODULE_AUTOLOAD += "${@bb.utils.contains('COMBINED_FEATURES', 'usbgadget', ' g_ether', '',d)}"

##############################################################################
# U-BOOT symbol definitions
#
# SPL_BINARY
#   Specify the name of U-boot SPL binary. No SPL is needed if it is empty.
##############################################################################
SPL_BINARY=""
UBOOT_EXTLINUX = "0"
UBOOT_CONFIG = ""
UBOOT_MACHINE = "pico-pi-imx7d_defconfig"
UBOOT_SUFFIX = "bin"
UBOOT_ENTRYPOINT = "0x80800000"
UBOOT_DTB_LOADADDRESS = "0x83000000"
UBOOT_IMAGE = "mbl-u-boot.bin"
UBOOT_SIGN_ENABLE = "1"

WKS_FILES = "${MACHINE}.wks"

# meta-mbl's linux-firmware bbappend (for imx7d-pico-mbl support) conflicts
# with meta-raspberrypi's linux-firmware bbappend (for rpi support). Make sure
# meta-raspberrypi's bbappend doesn't get used for imx7d-pico-mbl.
BBMASK += "/meta-raspberrypi/recipes-kernel/linux-firmware/"

# Specify the ATF recipe to be used for this machine.
PREFERRED_PROVIDER_virtual/atf = "atf-${MACHINE}"

# Don't use any of the firmware-imx-* packages - they're covered by a EULA that
# prevents us doing binary releases
MACHINE_EXTRA_RRECOMMENDS_remove = "firmware-imx-brcm"
MACHINE_EXTRA_RRECOMMENDS_remove = "firmware-imx-vpu-imx6d"
MACHINE_EXTRA_RRECOMMENDS_remove = "firmware-imx-vpu-imx6q"
PACKAGE_EXCLUDE += "firmware-imx-vpu-imx6d"
PACKAGE_EXCLUDE += "firmware-imx-vpu-imx6q"
PACKAGE_EXCLUDE += "firmware-imx-brcm"

INITRAMFS_IMAGE = "mbl-image-initramfs"
```

## conf/machine/imx7s-warp-mbl.conf
```bitbake
# Copyright (c) 2018 Arm Limited and Contributors. All rights reserved.
#
# SPDX-License-Identifier: MIT

#@TYPE: Machine
#@NAME: NXP WaRP7 Development Board
#@DESCRIPTION: Machine configuration for the WaRP7 board with extra features enabled

MACHINEOVERRIDES =. "imx7s-warp:${MACHINE}:"
include conf/machine/imx7s-warp.conf

# ------------------------------------------------------------------------------
# non-MBL-specific (upstreamable) configuration
# ------------------------------------------------------------------------------

MACHINE_EXTRA_RRECOMMENDS += "linux-firmware-bcm43430 linux-firmware-cyw43430a1"

# ------------------------------------------------------------------------------
# MBL-specific (non-upstreamable) configuration
# ------------------------------------------------------------------------------

KERNEL_CLASSES  = "mbl-fitimage"
KERNEL_IMAGETYPE = "fitImage"
KERNEL_DEVICETREE = "imx7s-warp.dtb"

##############################################################################
# U-BOOT Symbol Definitions
#
# UBOOT_SIGN_ENABLE
#   This is used to enable u-boot verified boot. See uboot-sign.bbclass for 
#   more information.
##############################################################################
UBOOT_CONFIG = ""
UBOOT_CONFIG[sd] = ""
UBOOT_MACHINE = "warp7_bl33_defconfig"
UBOOT_SUFFIX = "bin"
UBOOT_LOADADDRESS = "0x80800000"
UBOOT_ENTRYPOINT = "0x80800000"
UBOOT_DTB_LOADADDRESS = "0x83000000"
UBOOT_IMAGE = "mbl-u-boot.bin"
UBOOT_SIGN_ENABLE = "1"

WKS_FILE = "mbl-imx7s-warp.wks"

IMAGE_BOOT_FILES += "mbl-bootfiles/* \
		"

# meta-mbl's linux-firmware bbappend (for imx7s-warp-mbl support) conflicts
# with meta-raspberrypi's linux-firmware bbappend (for rpi support). Make sure
# meta-raspberrypi's bbappend doesn't get used for imx7s-warp-mbl.
BBMASK += "/meta-raspberrypi/recipes-kernel/linux-firmware/"

# Include the ATF recipe in the build
PREFERRED_PROVIDER_virtual/atf = "atf-warp7"
```

## conf/machine/imx8mmevk-mbl.conf
```bitbake
# Copyright (c) 2019 Arm Limited and Contributors. All rights reserved.
#
# SPDX-License-Identifier: MIT

#@TYPE: Machine
#@NAME: NXP i.MX8MM Evaluation Kit
#@SOC: i.MX8MM
#@DESCRIPTION: Machine configuration for NXP i.MX8MMini EVK with extra features enabled

MACHINEOVERRIDES =. "imx8mmevk:${MACHINE}:"
include conf/machine/imx8mmevk.conf

# ------------------------------------------------------------------------------
# MBL-specific (non-upstreamable) configuration
# ------------------------------------------------------------------------------


##############################################################################
# KERNEL symbol definitions for virtual/kernel build configuration
#
##############################################################################
# Not supported in the 4.14 FSL kernel tree
KERNEL_DEVICETREE_remove = "freescale/fsl-imx8mm-evk-inmate.dtb "

# This directive is a temporary measure and will be changed when the
# imx8mmevk-mbl BSP implements a recipe to create a FIT image consistent
# with the MBL bootflow.
PREFERRED_PROVIDER_virtual/bootloader = "u-boot-imx"

# This directive is a temporary measure and will be changed when the
# imx8mmevk-mbl BSP implements a recipe to apply MBL specific changes and
# additions.
PREFERRED_PROVIDER_virtual/kernel = "linux-imx"

# This directive is a temporary measure and will be changed when the
# imx8mmevk-mbl BSP implements atf-${MACHINE}.bb to create the FIP image.
# However, until that time, the meta-freescale ATF recipe is used.
PREFERRED_PROVIDER_virtual/atf = "imx-atf"

# define wks
WKS_FILE = "${MACHINE}.wks"

# imx-boot package - pulls in firmware binaries for training DDR
MACHINE_EXTRA_RRECOMMENDS += " imx-boot"

# This directive is a temporary measure and will be removed when the
# imx8mmevk-mbl BSP adopts mbl-fitimage.bbclass for preparing the
# FIT image, which installs boot.scr in MBL_FIT_IMAGE_BOOT_FILES_DIR.
# However, until that time, the boot.scr (FIT image) is added directly
# to IMAGE_BOOT_FILES.
IMAGE_BOOT_FILES += "boot.scr"

# These two directives are a temporary measure and will be removed when the
# imx8mmevk-mbl BSP adopts mbl-fitimage.bbclass.
# When we move to fit the kernel Image and initramfs will be individually
# crypotgraphically signed inside of the FIT.
# Here we remove the standalone kernel Image and instead include the
# concatonated Kernel + Initramfs.
# A corresponding change to boot.scr points u-boot $image to
# "Image-initramfs-imx8mmevk-mbl.bin" instead of "Image".
IMAGE_BOOT_FILES_remove = "Image"
IMAGE_BOOT_FILES += "Image-initramfs-imx8mmevk-mbl.bin"

# This dependency is a temporary measure and will be removed when the
# imx8mmevk-mbl BSP adopts mbl-fitimage.bbclass to create the FIT
# image. However, at the present time mbl-boot-scr.bbappend is used to
# create the FIT image and hence the following dependency is present.
do_image_wic[depends] += "mbl-boot-scr:do_deploy"

BBMASK += "/meta-raspberrypi/recipes-kernel/linux-firmware/"

INITRAMFS_IMAGE = "mbl-image-initramfs"

# Add in WiFi driver and firmware from meta-freescale-bsp-release
BBFILES += "${OEROOT}/layers/meta-fsl-bsp-release/imx/meta-bsp/recipes-kernel/kernel-modules/kernel-module-qca9377_2.1.bb \
            ${OEROOT}/layers/meta-fsl-bsp-release/imx/meta-bsp/recipes-kernel/kernel-modules/kernel-module-qcacld-lea.inc"
MACHINE_EXTRA_RRECOMMENDS_append = " kernel-module-qca9377 "
```
