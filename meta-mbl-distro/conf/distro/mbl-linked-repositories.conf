## recipes-bsp/mbl-boot-scr/files/imx7s-warp-mbl/boot.its
```
/*
 * Warp7 FIT image with kernel, initramfs and boot script.
 *
 */

/dts-v1/;

/ {
	description = "FIT image for Warp7";
	#address-cells = <1>;

	images {
		bootscr {
			description = "boot.scr";
			data = /incbin/("boot.cmd");
			type = "script";
			arch = "arm";
			compression = "none";
			load = <0x87000000>;
			hash@1 {
				algo = "sha1";
			};
		};

		kernel@1 {
			description = "kernel";
			data = /incbin/("zImage");
			arch = "arm";
			type = "kernel";
			os = "linux";
			compression = "none";
			load = <0x80800000>;
			entry = <0x80800000>;
			hash@1 {
				algo = "sha1";
			};
		};

		ramdisk@1 {
			description = "initramfs";
			data = /incbin/("mbl-console-image-initramfs-imx7s-warp-mbl.cpio.gz");
			arch = "arm";
			os = "linux";
			type = "ramdisk";
			compression = "gzip";
			load = <0x82000000>;
			entry = <0x82000000>;
			hash@1 {
				algo = "sha1";
			};
		};
	};

	configurations {
		default = "conf@0";

		conf@0 {
			description = "imx7s-bootscr-kernel-initramfs";
			kernel = "kernel@1";
			ramdisk = "ramdisk@1";
			loadables = "bootscr", "kernel", "ramdisk";
			signature@1 {
				algo = "sha1,rsa2048";
				key-name-hint = "mblkey";
				sign-images = "loadables";
			};
		};
	};
};
```

## recipes-bsp/mbl-boot-scr/files/raspberrypi3-mbl/boot.its
```
/*
 * FIT image description file for the usage of multiple images loaded by uboot.
 */

/dts-v1/;

/ {
	description = "multiple firmware blobs, loaded by U-Boot";
	#address-cells = <0x1>;

	images {

		kernel@1 {
			description = "kernel";
			data = /incbin/("zImage");
			arch = "arm";
			type = "kernel";
			os = "linux";
			compression = "none";
			load = <0x04000000>;
			entry = <0x04000000>;
			hash@1 {
				algo = "sha1";
			};
		};

		fdt@1 {
			description = "Raspberrypi DT";
			data = /incbin/("bcm2710-rpi-3-b-plus.dtb");
			arch = "arm";
			type = "flat_dt";
			compression = "none";
			load = <0x03000000>;
			hash@1 {
				algo = "sha1";
			};
		};

		ramdisk@1 {
			description = "initramfs";
			data = /incbin/("mbl-console-image-initramfs-raspberrypi3-mbl.cpio.gz");
			arch = "arm";
			os = "linux";
			type = "ramdisk";
			compression = "gzip";
			load = <0x05800000>;
			entry = <0x05800000>;
			hash@1 {
				algo = "sha1";
			};
		};

		bootscr {
			description = "boot.scr";
			data = /incbin/("boot.cmd");
			type = "script";
			arch = "arm";
			compression = "none";
			hash@1 {
				algo = "sha1";
			};
		};
	};

	configurations {
		default = "config@1";

		config@1 {
			description = "raspberrypi3";
			kernel = "kernel@1";
			fdt = "fdt@1";
			ramdisk = "ramdisk@1";
			loadables = "bootscr", "fdt", "kernel", "ramdisk";
			signature@1 {
				algo = "sha1,rsa2048";
				key-name-hint = "mblkey";
				sign-images = "loadables";
			};
		};
	};
};
```

## recipes-bsp/mbl-boot-scr/files/raspberrypi3/boot.its
```
/*
 * Copyright (C) 2018 Linaro Ltd.
 *
 * Minimal dts for a boot.scr image payload.
 *
 */

/dts-v1/;

/ {
	description = "FIT image boot.scr";
	#address-cells = <1>;

	images {
		bootscr {
			description = "boot.scr";
			data = /incbin/("boot.cmd");
			type = "script";
			arch = "standalone";
			compression = "none";
			hash@1 {
				algo = "sha1";
			};
			signature@1 {
				algo = "sha1,rsa2048";
				key-name-hint = "dev";
			};
		};
	};

	configurations {
		default = "conf@1";
		conf@1 {
			description = "raspberrypi3-boot-scr";
			loadables = "bootscr";
			signature@1 {
				algo = "sha1,rsa2048";
				key-name-hint = "dev";
				sign-images = "loadables";
			};
		};
	};
};
```

## recipes-bsp/u-boot/u-boot-fslc/dummy.its
```
/*
 * Minimal dts for a FIT image payload.
 * We only need to embed public key into device tree, and do not care
 * the output FIT image. So you can add any file into FIT image.
 *
 * SPDX-License-Identifier: GPL-2.0+  X11
 */

/dts-v1/;

/ {
	description = "FIT image with U-Boot";
	#address-cells = <1>;

	images {
		fdt@1 {
			description = "dummy file";
			data = /incbin/("dummy.its");
			type = "firmware";
			arch = "arm";
			compression = "none";
			hash@1 {
				algo = "sha1";
			};
		};
	};

	configurations {
		default = "conf@1";
		conf@1 {
			fdt = "fdt@1";
			loadables = "fdt@1";
			signature@1 {
				algo = "sha1,rsa2048";
				key-name-hint = "mblkey";
			};
		};
	};
};
```

## recipes-bsp/u-boot/u-boot/dummy.its
```
/*
 * Minimal dts for a FIT image payload.
 *
 * SPDX-License-Identifier: GPL-2.0+  X11
 */

/dts-v1/;

/ {
	description = "FIT image with U-Boot";
	#address-cells = <1>;

	images {
		fdt@1 {
			description = "Device Tree";
			data = /incbin/("dts/dt.dtb");
			type = "firmware";
			arch = "arm";
			compression = "none";
			hash@1 {
				algo = "sha1";
			};
		};
	};

	configurations {
		default = "conf@1";
		conf@1 {
			fdt = "fdt@1";
			loadables = "fdt@1";
			signature@1 {
				algo = "sha1,rsa2048";
				key-name-hint = "mblkey";
			};
		};
	};
};
```

## recipes-kernel/linux/files/kernel.its
```
/dts-v1/;

/*
 * FIT image description file for the usage of multiple images loaded by uboot.
 */

/ {
	description = "multiple firmware blobs, loaded by U-Boot";
	#address-cells = <0x1>;

	images {

		kernel@1 {
			description = "kernel";
			data = /incbin/("zImage");
			arch = "arm";
			type = "kernel";
			os = "linux";
			compression = "none";
			load = <0x80800000>;
			entry = <0x80800000>;
			signature@1 {
				algo = "sha1,rsa2048";
				key-name-hint = "dev";
			};
		};
		ramdisk@1 {
			description = "initramfs";
			data = /incbin/("mbl-console-image-initramfs-imx7s-warp-mbl.cpio.gz");
			arch = "arm";
			os = "linux";
			type = "ramdisk";
			compression = "gzip";
			load = <0x82000000>;
			entry = <0x82000000>;
			signature@1 {
				algo = "sha1,rsa2048";
				key-name-hint = "dev";
			};
		};
	};

	configurations {
		default = "config@1";

		config@1 {
			description = "imx7s-warp";
			kernel = "kernel@1";
			ramdisk = "ramdisk@1";
			signature@1 {
				algo = "sha1,rsa2048";
				key-name-hint = "dev";
				sign-images = "ramdisk", "kernel";
			};
		};
	};
};
```

## recipes-kernel/linux/linux-mainline/kernel.its
```
/dts-v1/;

/*
 * FIT image description file for the usage of multiple images loaded by uboot.
 */

/ {
	description = "multiple firmware blobs, loaded by U-Boot";
	#address-cells = <0x1>;

	images {

		kernel@1 {
			description = "4.9 kernel";
			data = /incbin/("zImage");
			arch = "arm";
			type = "kernel";
			os = "linux";
			compression = "none";
			load = <0x42000000>;
			entry = <0x42000000>;
			hash@1 {
				algo = "sha1";
			};
		};

		fdt@1 {
			description = "Bananapi Zero DT";
			data = /incbin/("sun8i-h2-plus-bananapi-m2-zero.dtb");
			arch = "arm";
			type = "flat_dt";
			compression = "none";
			load = <0x43000000>;
			hash@1 {
				algo = "sha1";
			};
		};
	};

	configurations {
		default = "config@1";

		config@1 {
			description = "sun8i-h2-plus-bananapi-m2-zero";
			kernel = "kernel@1";
			fdt = "fdt@1";
			signature@1 {
				algo = "sha1,rsa2048";
				key-name-hint = "dev";
				sign-images = "fdt", "kernel";
			};
		};
	};
};
```

## recipes-kernel/linux/linux-raspberrypi/kernel.its
```
/dts-v1/;

/*
 * FIT image description file for the usage of multiple images loaded by uboot.
 */

/ {
	description = "multiple firmware blobs, loaded by U-Boot";
	#address-cells = <0x1>;

	images {

		kernel@1 {
			description = "kernel";
			data = /incbin/("zImage");
			arch = "arm";
			type = "kernel";
			os = "linux";
			compression = "none";
			load = <0x04000000>;
			entry = <0x04000000>;
			signature@1 {
				algo = "sha1,rsa2048";
				key-name-hint = "dev";
			};
		};

		fdt@1 {
			description = "Raspberrypi DT";
			data = /incbin/("bcm2710-rpi-3-b.dtb");
			arch = "arm";
			type = "flat_dt";
			compression = "none";
			load = <0x03800000>;
			signature@1 {
				algo = "sha1,rsa2048";
				key-name-hint = "dev";
			};
		};
	};

	configurations {
		default = "config@1";

		config@1 {
			description = "raspberrypi3";
			kernel = "kernel@1";
			fdt = "fdt@1";
			signature@1 {
				algo = "sha1,rsa2048";
				key-name-hint = "dev";
				sign-images = "fdt", "kernel";
			};
		};
	};
};
```

## wic/imx7d-pico-mbl.wks
```
# Copyright (c) 2018 Arm Limited and Contributors. All rights reserved.
#
# SPDX-License-Identifier: BSD-3-Clause

# Specification of partitioning of imx7d-pico mmc to support mbed Update
# See docs/partitions.md

# Note 1: don't specify mount points and "on-device" options - if we do that then
# WIC will try to add the devices to fstab, but it will only add them to fstab
# in the final wic image, not the rootfs images. That would be a problem for us
# because we use the rootfs images as firmware files for Update. We just deal
# with fstab manually to avoid this.
#
# Note 2: the labels are important - fstab uses them and so does activate_script.

# Raw copy of SPL and U-boot binary.
part SPL --source rawcopy --sourceparams="file=SPL" --no-table --align 1
part u-boot --source rawcopy --sourceparams="file=u-boot.img" --no-table --align 69

# Partition 1: Boot partition
part --source bootimg-partition --fstype=vfat --label boot --active --align 4096 --fixed-size 32

# Partition 2: Boot flags
part --fstype=ext4 --label bootflags --fixed-size 20

# Partition 3: First root partition
part --source rootfs --fstype=ext4 --label rootfs1 --fixed-size 500

# Partition 4: Second root partition
part --source rootfs --fstype=ext4 --label rootfs2 --fixed-size 500

# Partition 5: Factory config partition
part --fstype=ext4 --label factory_config --fixed-size 20

# Partition 6: First non-factory config partition
part --source rootfs-subdir --sourceparams subdir=config/user --fstype=ext4 --label nfactory_config1 --fixed-size 20

# Partition 7: Second non-factory config partition
part --fstype=ext4 --label nfactory_config2 --fixed-size 20

# Partition 8: Log partition
part --fstype=ext4 --label log --fixed-size 20

# Partition 9: Scratch partition
part --source rootfs-subdir --sourceparams subdir=scratch --fstype=ext4 --label scratch --fixed-size 500

# Partition 10: First rootfs verity hash partition
part --source non-rootfs-subdir --sourceparams subdir=verity_hash --fstype=ext4 --label rootfs1_ver_hash --fixed-size 20

# Partition 11: Second rootfs verity hash partition
part --fstype=ext4 --label rootfs2_ver_hash --fixed-size 20

# Partition 12: Home partition
part --source rootfs-subdir --sourceparams subdir=home --fstype=ext4 --label home --fixed-size 450

bootloader --ptable msdos
```

## wic/mbl-imx7s-warp.wks
```
# Specification of partitioning of warp7 mmc to support mbed Update
# See docs/partitions.md

# Note 1: don't specify mount points and "on-device" options - if we do that then
# WIC will try to add the devices to fstab, but it will only add them to fstab
# in the final wic image, not the rootfs images. That would be a problem for us
# because we use the rootfs images as firmware files for Update. We just deal
# with fstab manually to avoid this.
#
# Note 2: the labels are important - fstab uses them and so does activate_script.

# Partition 0: Raw copy of U-boot binary.
part --source rawcopy --sourceparams="file=atf-bl2-fip.bin" --no-table --align 1

# Partition 1: Boot partition
part --source bootimg-partition --fstype=vfat --label boot --active --align 4096 --fixed-size 32

# Partition 2: Boot flags
part --fstype=ext4 --label bootflags --fixed-size 20

# Partition 3: First root partition
part --source rootfs --fstype=ext4 --exclude-path=config/ --label rootfs1 --fixed-size 500

# Partition 4: Second root partition
part --source rootfs --fstype=ext4 --exclude-path=config/ --label rootfs2 --fixed-size 500

# Partition 5: Config partition
part --source rootfs-subdir --sourceparams subdir=config --fstype=ext4 --label config --fixed-size 40

# Partition 6: Factory config partition
part --fstype=ext4 --label factory_config --fixed-size 20

# Partition 7: Cache partition
part --source rootfs-subdir --sourceparams subdir=mnt/cache/ --fstype=ext4 --label cache --fixed-size 500

# Partition 8: First rootfs verity hash partition
part --source non-rootfs-subdir --sourceparams subdir=verity_hash --fstype=ext4 --label rootfs1_ver_hash --fixed-size 20

# Partition 9: Second rootfs verity hash partition
part --fstype=ext4 --label rootfs2_ver_hash --fixed-size 20

# Partition 10: Home partition
part --source rootfs-subdir --sourceparams subdir=home --fstype=ext4 --label home --fixed-size 450


bootloader --ptable msdos
```
