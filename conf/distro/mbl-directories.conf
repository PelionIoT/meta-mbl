## meta-freescale-3rdparty-mbl/conf/machine/imx7d-pico-mbl.conf
```bitbake
# Copyright (c) 2018 Arm Limited and Contributors. All rights reserved.
#
# SPDX-License-Identifier: MIT

#@TYPE: Machine
#@NAME: NXP IMX7D PICO-PI Development Board
#@DESCRIPTION: Machine configuration for the PICO PI board

MACHINEOVERRIDES =. "imx7d-pico:${MACHINE}:"
include conf/machine/imx7d-pico.conf
require conf/include/mbl-default.conf

# ------------------------------------------------------------------------------
# non-MBL-specific (upstreamable) configuration
# ------------------------------------------------------------------------------
SERIAL_CONSOLES = "115200;ttymxc4"

# ------------------------------------------------------------------------------
# MBL-specific (non-upstreamable) configuration
# ------------------------------------------------------------------------------


##############################################################################
# KERNEL symbol definitions for virtual/kernel build configuration
#
# KERNEL_CLASSES
#   mbl-fitimage.bbclass is inherited into kernel.bbclass processing by
#   defining this symbol to include mbl-fitimage.
# KERNEL_IMAGETYPE
#   The kernel is packages in a FIT image by specifying "fitImage"
# KERNEL_DEVICETREE
#   Its unnecessary to change this symbol here as the required
#   "imx7s-warp.dtb" value is specified in imx7s-warp.conf (included above)
##############################################################################
KERNEL_CLASSES  = "mbl-fitimage"
KERNEL_DEVICETREE = "imx7d-pico.dtb"
KERNEL_IMAGETYPE = "fitImage"

##############################################################################
# U-BOOT symbol definitions
#
# SPL_BINARY
#   Specify the name of U-boot SPL binary. No SPL is needed if it is empty.
##############################################################################
SPL_BINARY=""
UBOOT_EXTLINUX = "0"
UBOOT_CONFIG = ""
UBOOT_MACHINE = "pico-pi-imx7d_defconfig"
UBOOT_SUFFIX = "bin"
UBOOT_BINARY = "u-boot.${UBOOT_SUFFIX}"
UBOOT_ENTRYPOINT = "0x80800000"
UBOOT_DTB_LOADADDRESS = "0x83000000"
UBOOT_IMAGE = "mbl-u-boot.bin"
UBOOT_SIGN_ENABLE = "1"

# WKS_FILES is a priority ordered list of .wks files to look for (see
# image_types_wic.bbclass). The default value of WKS_FILES has ${WKS_FILE}
# listed first so that the user can set the .wks file by setting WKS_FILE.
#
# meta-freescale-3rdparty's imx7d-pico.conf sets WKS_FILES to
# "imx-uboot-spl.wks", but that prevents specifying the .wks file in WKS_FILE.
# Fix that here re-setting WKS_FILES to list ${WKS_FILE} first. There's not
# much point in us giving imx-uboot-spl.wks as a second item in the list (to
# use as a default .wks file for when WKS_FILE isn't set) because our BSP
# doesn't use SPL.
WKS_FILES = "${WKS_FILE}"

# Remove all recipes except kernel modules recipe in fsl-bsp-release
BBMASK += "/meta-fsl-bsp-release/imx/meta-bsp/classes/"
BBMASK += "/meta-fsl-bsp-release/imx/meta-bsp/recipes-browser/"
BBMASK += "/meta-fsl-bsp-release/imx/meta-bsp/recipes-connectivity/"
BBMASK += "/meta-fsl-bsp-release/imx/meta-bsp/recipes-core/"
BBMASK += "/meta-fsl-bsp-release/imx/meta-bsp/recipes-devtools/"
BBMASK += "/meta-fsl-bsp-release/imx/meta-bsp/recipes-graphics/"
BBMASK += "/meta-fsl-bsp-release/imx/meta-bsp/recipes-multimedia/"
BBMASK += "/meta-fsl-bsp-release/imx/meta-bsp/recipes-security/"
BBMASK += "/meta-fsl-bsp-release/imx/meta-bsp/recipes-utils/"
BBMASK += "/meta-fsl-bsp-release/imx/meta-bsp/recipes-kernel/linux/"
BBMASK += "/meta-fsl-bsp-release/imx/meta-bsp/recipes-kernel/linux-firmware/"
BBMASK += "/meta-fsl-bsp-release/imx/meta-bsp/recipes-kernel/kernel-modules/kernel-module-imx-gpu-viv*.bb"

# Because of license restrictions we want to use fsl-eula-unpack.bbclass from
# meta-fsl-bsp-release instead the one provided by meta-freescale.
# Also mask firmware-imx in meta-fsl-bsp-release-mbl to avoid missing
# target file error for bbappend file.
BBMASK += "/meta-fsl-bsp-release/imx/meta-bsp/recipes-bsp/(?!firmware-qca)"
BBMASK += "/meta-fsl-bsp-release/imx/meta-bsp/classes/(?!fsl-eula-unpack\.bbclass)"
BBMASK += "/meta-freescale/classes/fsl-eula-unpack.bbclass"
BBMASK += "/meta-mbl/meta-fsl-bsp-release-mbl/imx/meta-bsp/recipes-bsp/firmware-imx/"

# We need to set the EULA file from meta-fsl-bsp-release instead of
# meta-freescale/EULA
FSL_EULA_FILE = "${OEROOT}/layers/meta-fsl-bsp-release/imx/EULA.txt"

# Specify the ATF recipe to be used for this machine.
PREFERRED_PROVIDER_virtual/atf = "atf-${MACHINE}"

# Don't use any of the firmware-imx-* packages - they're covered by a EULA that
# prevents us doing binary releases
MACHINE_EXTRA_RRECOMMENDS_remove = "firmware-imx-brcm"
MACHINE_EXTRA_RRECOMMENDS_remove = "firmware-imx-vpu-imx6d"
MACHINE_EXTRA_RRECOMMENDS_remove = "firmware-imx-vpu-imx6q"
PACKAGE_EXCLUDE += "firmware-imx-vpu-imx6d"
PACKAGE_EXCLUDE += "firmware-imx-vpu-imx6q"
PACKAGE_EXCLUDE += "firmware-imx-brcm"

# Specify qca9377 firmware binary to be released with this machine, otherwise
# only script is released to download binary on the board later.
MACHINE_FEATURES += "qca9377-bin"

# Add in WiFi driver and firmware from meta-freescale-bsp-release
MACHINE_EXTRA_RRECOMMENDS_append = " kernel-module-qca9377 "
MACHINE_EXTRA_RRECOMMENDS_append = " \
    ${@bb.utils.contains('MACHINE_FEATURES', 'qca9377-bin', 'firmware-qca9377', 'kernel-module-qca9377-firmware-tools', d)} \
"
```

## meta-freescale-3rdparty-mbl/conf/machine/imx7s-warp-mbl.conf
```bitbake
# Copyright (c) 2018 Arm Limited and Contributors. All rights reserved.
#
# SPDX-License-Identifier: MIT

#@TYPE: Machine
#@NAME: NXP WaRP7 Development Board
#@DESCRIPTION: Machine configuration for the WaRP7 board with extra features enabled

MACHINEOVERRIDES =. "imx7s-warp:${MACHINE}:"
include conf/machine/imx7s-warp.conf
require conf/include/mbl-default.conf

# ------------------------------------------------------------------------------
# non-MBL-specific (upstreamable) configuration
# ------------------------------------------------------------------------------
SERIAL_CONSOLES = "115200;ttymxc0"

MACHINE_EXTRA_RRECOMMENDS += "linux-firmware-bcm43430 bluez-firmware-warp7distro-bcm43430a1-hcd"

# ------------------------------------------------------------------------------
# MBL-specific (non-upstreamable) configuration
# ------------------------------------------------------------------------------


##############################################################################
# KERNEL symbol definitions for virtual/kernel build configuration
#
# KERNEL_CLASSES
#   mbl-fitimage.bbclass is inherited into kernel.bbclass processing by
#   defining this symbol to include mbl-fitimage.
# KERNEL_IMAGETYPE
#   The kernel is packages in a FIT image by specifying "fitImage"
# KERNEL_DEVICETREE
#   Its unnecessary to change this symbol here as the required
#   "imx7s-warp.dtb" value is specified in imx7s-warp.conf (included above)
KERNEL_CLASSES  = "mbl-fitimage"
KERNEL_IMAGETYPE = "fitImage"

##############################################################################
# U-BOOT symbol definitions
#
# UBOOT_SIGN_ENABLE
#   This is used to enable u-boot verified boot. See uboot-sign.bbclass for
#   more information.
##############################################################################
UBOOT_CONFIG = ""
UBOOT_CONFIG[sd] = ""
UBOOT_MACHINE = "warp7_bl33_defconfig"
UBOOT_SUFFIX = "bin"
UBOOT_BINARY = "u-boot.${UBOOT_SUFFIX}"
UBOOT_ENTRYPOINT = "0x80800000"
UBOOT_DTB_LOADADDRESS = "0x83000000"
UBOOT_IMAGE = "mbl-u-boot.bin"
UBOOT_SIGN_ENABLE = "1"

# Specify the ATF recipe to be used for this machine.
PREFERRED_PROVIDER_virtual/atf = "atf-${MACHINE}"

# Don't use any of the firmware-imx-* packages - they're covered by a EULA that
# prevents us doing binary releases
MACHINE_EXTRA_RRECOMMENDS_remove = "firmware-imx-brcm"
MACHINE_EXTRA_RRECOMMENDS_remove = "firmware-imx-vpu-imx6d"
MACHINE_EXTRA_RRECOMMENDS_remove = "firmware-imx-vpu-imx6q"
MACHINE_EXTRA_RRECOMMENDS_remove = "bcm43430-nvram-config"
PACKAGE_EXCLUDE += "firmware-imx-vpu-imx6d"
PACKAGE_EXCLUDE += "firmware-imx-vpu-imx6q"
PACKAGE_EXCLUDE += "firmware-imx-brcm"

# The name of the usbgadget ethernet interface to be used for debugging
MBL_DBG_IFNAME = "usbdbg0"

##############################################################################
# Partition layout config
##############################################################################
MBL_WKS_BOOTLOADER1_FILENAME = "bl2.bin.imx"
MBL_WKS_BOOTLOADER1_OFFSET_BANK1_KiB = "1"
MBL_WKS_BOOTLOADER1_IS_BL2 = "1"

MBL_WKS_BOOTLOADER2_IS_BL3 = "1"

# As reported by "mmc extcsd read /dev/mmcblk1"
MBL_FLASH_ERASE_BLOCK_SIZE_KiB = "6144"

# "blockdev --getsize64 /dev/mmcblk1" reports 7650410496B (= 7296MiB)
MBL_WKS_STORAGE_SIZE_MiB = "7296"

##############################################################################
# SystemD watchdog config
##############################################################################
# Set the max timeout. The imx series watchdog driver explicitly defines a max
# watchdog timeout of 128 seconds.
MBL_WATCHDOG_TIMEOUT_SECS ?= "128"
# Set the device file name for the hardware watchdog
MBL_WATCHDOG_DEVICE_FILENAME ?= "/dev/watchdog"
```

## meta-freescale-mbl/conf/layer.conf
```bitbake
# Copyright (c) 2019 Arm Limited and Contributors. All rights reserved.
#
# SPDX-License-Identifier: MIT
#
# mbed linux layer configuration file
BBPATH .= ":${LAYERDIR}"

# We have a recipes directory, add to BBFILES
BBFILES += "${LAYERDIR}/recipes*/*/*.bb ${LAYERDIR}/recipes*/*/*.bbappend"

BBFILE_COLLECTIONS += "freescale-layer-mbl"
BBFILE_PATTERN_freescale-layer-mbl := "^${LAYERDIR}/"

LAYERSERIES_COMPAT_freescale-layer-mbl = "warrior"
LAYERDEPENDS_freescale-layer-mbl = "freescale-layer"
LAYERDEPENDS_freescale-layer-mbl += "meta-mbl-bsp-common"
```
