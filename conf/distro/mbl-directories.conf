## meta-freescale-mbl/conf/machine/imx8mmevk-mbl.conf
```bitbake
# Copyright (c) 2019 Arm Limited and Contributors. All rights reserved.
#
# SPDX-License-Identifier: MIT

#@TYPE: Machine
#@NAME: NXP i.MX8MM Evaluation Kit
#@SOC: i.MX8MM
#@DESCRIPTION: Machine configuration for NXP i.MX8MMini EVK with extra features enabled

MACHINEOVERRIDES =. "imx8mmevk:${MACHINE}:"
include conf/machine/imx8mmevk.conf
require conf/include/mbl-default.conf

# ------------------------------------------------------------------------------
# MBL-specific (non-upstreamable) configuration
# ------------------------------------------------------------------------------

##############################################################################
# KERNEL symbol definitions for virtual/kernel build configuration
#
# KERNEL_CLASSES
#   mbl-fitimage.bbclass is inherited into kernel.bbclass processing by
#   defining this symbol to include mbl-fitimage.
# KERNEL_IMAGETYPE
#   The kernel is packages in a FIT image by specifying "fitImage"
# KERNEL_DEVICETREE
#   The kernel device tree is set to "freescale/fsl-imx8mm-evk.dtb" and
#   will put in FIT.
##############################################################################
KERNEL_CLASSES  = "mbl-fitimage"
KERNEL_DEVICETREE = "freescale/fsl-imx8mm-evk.dtb"
KERNEL_IMAGETYPES = "fitImage"

# Not supported in the 4.14 FSL kernel tree
KERNEL_DEVICETREE_remove = "freescale/fsl-imx8mm-evk-inmate.dtb "

# This directive is a temporary measure and will be changed when the
# imx8mmevk-mbl BSP implements a recipe to create a FIT image consistent
# with the MBL bootflow.
PREFERRED_PROVIDER_virtual/bootloader = "u-boot-imx"

##############################################################################
# U-BOOT symbol definitions
#
# SPL_BINARY
#   Specify the name of U-boot SPL binary. No SPL is needed if it is empty.
# UBOOT_CONFIG[sd]
#   Refers to the MBL specific u-boot config for sdcard
#   necessary for any differentation required @ u-boot level for mbed Linux.
##############################################################################
UBOOT_SUFFIX = "bin"
UBOOT_BINARY = "u-boot.${UBOOT_SUFFIX}"
UBOOT_CONFIG[sd] = "imx8mm_evk_mbl_config,sdcard"
UBOOT_ENTRYPOINT = "0x40480000"
UBOOT_DTB_LOADADDRESS = "0x43000000"
UBOOT_IMAGE = "mbl-u-boot.bin"
UBOOT_SIGN_ENABLE = "1"

# This directive is a temporary measure and will be changed when the
# imx8mmevk-mbl BSP implements a recipe to apply MBL specific changes and
# additions.
PREFERRED_PROVIDER_virtual/kernel = "linux-imx"

# Specify the ATF recipe to be used for this machine.
PREFERRED_PROVIDER_virtual/atf = "atf-${MACHINE}"

# imx-boot package - pulls in firmware binaries for training DDR
MACHINE_EXTRA_RRECOMMENDS += " imx-boot"

# Here we remove the standalone kernel Image and instead include the FIT image
# in mbl-fitimage class.
IMAGE_BOOT_FILES_remove = "Image"

# Remove all recipes except kernel modules recipe in fsl-bsp-release
BBMASK += "/meta-fsl-bsp-release/imx/meta-bsp/recipes-browser/"
BBMASK += "/meta-fsl-bsp-release/imx/meta-bsp/recipes-connectivity/"
BBMASK += "/meta-fsl-bsp-release/imx/meta-bsp/recipes-core/"
BBMASK += "/meta-fsl-bsp-release/imx/meta-bsp/recipes-devtools/"
BBMASK += "/meta-fsl-bsp-release/imx/meta-bsp/recipes-graphics/"
BBMASK += "/meta-fsl-bsp-release/imx/meta-bsp/recipes-multimedia/"
BBMASK += "/meta-fsl-bsp-release/imx/meta-bsp/recipes-security/"
BBMASK += "/meta-fsl-bsp-release/imx/meta-bsp/recipes-utils/"
BBMASK += "/meta-fsl-bsp-release/imx/meta-bsp/recipes-kernel/linux/"
BBMASK += "/meta-fsl-bsp-release/imx/meta-bsp/recipes-kernel/linux-firmware/"
BBMASK += "/meta-fsl-bsp-release/imx/meta-bsp/recipes-kernel/kernel-modules/kernel-module-imx-gpu-viv*.bb"

# Because of license restrictions we want to use the firmware-imx_8.0.bb and
# fsl-eula-unpack.bbclass from meta-fsl-bsp-release instead the one provided
# by meta-freescale.
BBMASK += "/meta-fsl-bsp-release/imx/meta-bsp/recipes-bsp/(?!firmware-(?:qca|imx))"
BBMASK += "/meta-fsl-bsp-release/imx/meta-bsp/classes/(?!fsl-eula-unpack\.bbclass)"
BBMASK += "/meta-freescale/recipes-bsp/firmware-imx"
BBMASK += "/meta-freescale/classes/fsl-eula-unpack.bbclass"

# We need to set the EULA file from meta-fsl-bsp-release instead of
# meta-freescale/EULA
FSL_EULA_FILE = "${OEROOT}/layers/meta-fsl-bsp-release/imx/EULA.txt"

INITRAMFS_IMAGE_BUNDLE = "1"

# Remove the Qualcomm Wifi firmware (qca*) RRECOMMENDS due to license restrictions
MACHINE_EXTRA_RRECOMMENDS_remove = "packagegroup-fsl-qca9377 packagegroup-fsl-qca6174"

# Specify qca9377 firmware binary to be released with this machine, otherwise
# only script is released to download binary on the board later.
MACHINE_FEATURES += "qca9377-bin"

# Add in WiFi driver from meta-freescale-bsp-release
MACHINE_EXTRA_RRECOMMENDS_append = " kernel-module-qca9377 "
MACHINE_EXTRA_RRECOMMENDS_append = " \
    ${@bb.utils.contains('MACHINE_FEATURES', 'qca9377-bin', 'firmware-qca9377', 'kernel-module-qca9377-firmware-tools', d)} \
"

MACHINE_FIRMWARE_remove = " linux-firmware-ath10k"

# The name of the usbgadget ethernet interface to be used for debugging
MBL_DBG_IFNAME = "usbdbg0"

##############################################################################
# Partition layout config
##############################################################################
MBL_WKS_BOOTLOADER1_FILENAME = "imx-boot-imx8mmevk-mbl-sd.bin-flash_evk"
MBL_WKS_BOOTLOADER1_OFFSET_BANK1_KiB = "33"
MBL_WKS_BOOTLOADER1_SIZE_KiB = "991"
MBL_WKS_BOOTLOADER1_IS_BL2 = "1"

MBL_WKS_BOOTLOADER2_FILENAME = "fip.bin"
MBL_WKS_BOOTLOADER2_SIZE_KiB = "2048"
MBL_WKS_BOOTLOADER2_IS_BL3 = "1"

# From "mmc extcsd read /dev/mmcblk2"
# Uncomment this if you are using the eMMC rather than an SD-Card
# MBL_FLASH_ERASE_BLOCK_SIZE_KiB = "512"

# The board's eMMC is "16GB", but we also support using an SD-Card. We assume
# an 8GB or larger SD Card. 8GB =~ 7.4GiB. Round down to 7GiB to be on the safe
# side.
#
# Override this variable in local.conf if you use the on-board eMMC or a
# different size of SD Card.
MBL_WKS_STORAGE_SIZE_MiB ?= "7168"

##############################################################################
# SystemD watchdog config
##############################################################################
# Set the max timeout. The imx series watchdog driver explicitly defines a max
# watchdog timeout of 128 seconds.
MBL_WATCHDOG_TIMEOUT_SECS ?= "128"
# Set the device file name for the hardware watchdog
MBL_WATCHDOG_DEVICE_FILENAME ?= "/dev/watchdog"
```

## meta-fsl-bsp-release-mbl/imx/meta-bsp/conf/layer.conf
```bitbake
# Copyright (c) 2019 Arm Limited and Contributors. All rights reserved.
#
# SPDX-License-Identifier: MIT

BBPATH .= ":${LAYERDIR}"

# We have a packages directory, add to BBFILES
BBFILES += "${LAYERDIR}/recipes-*/*/*.bb \
            ${LAYERDIR}/recipes-*/*/*.bbappend"

BBFILE_COLLECTIONS += "fsl-bsp-release-mbl"
BBFILE_PATTERN_fsl-bsp-release-mbl := "^${LAYERDIR}"
LAYERSERIES_COMPAT_fsl-bsp-release-mbl = "warrior"
LAYERDEPENDS_fsl-bsp-release-mbl = "fsl-bsp-release"
# Make dependent layers compatible with warrior
LAYERSERIES_COMPAT_fsl-bsp-release_append = " warrior"
```

## meta-linaro-mbl/meta-optee-mbl/conf/layer.conf
```bitbake
# We might have a conf and classes directory, append to BBPATH
BBPATH .= ":${LAYERDIR}"

# We have a recipes directory, add to BBFILES
BBFILES += "${LAYERDIR}/recipes*/*/*.bb ${LAYERDIR}/recipes*/*/*.bbappend"

BBFILE_COLLECTIONS += "meta-optee-mbl"
BBFILE_PATTERN_meta-optee-mbl := "^${LAYERDIR}/"
BBFILE_PRIORITY_meta-optee-mbl = "8"

LAYERSERIES_COMPAT_meta-optee-mbl = "thud warrior"
```

## meta-linaro-mbl/meta-optee/conf/layer.conf
```bitbake
# Copyright (c) 2019 Arm Limited and Contributors. All rights reserved.
#
# SPDX-License-Identifier: MIT
#
# mbed linux layer configuration file
BBPATH .= ":${LAYERDIR}"

# We have a recipes directory, add to BBFILES
BBFILES += "${LAYERDIR}/recipes*/*/*.bb ${LAYERDIR}/recipes*/*/*.bbappend"

BBFILE_COLLECTIONS += "meta-optee-mbl"
BBFILE_PATTERN_meta-optee-mbl := "^${LAYERDIR}/"

LAYERSERIES_COMPAT_meta-optee-mbl = "warrior"
LAYERDEPENDS_meta-optee-mbl = "meta-optee"

# Make dependent layer compatible with warrior
LAYERSERIES_COMPAT_meta-optee_append = " warrior"
```

## meta-mbl-apps/conf/layer.conf
```bitbake
# Copyright (c) 2019 Arm Limited and Contributors. All rights reserved.
#
# SPDX-License-Identifier: MIT
#
# mbed linux layer configuration file
BBPATH .= ":${LAYERDIR}"

# We have a recipes directory, add to BBFILES
BBFILES += "${LAYERDIR}/recipes*/*/*.bb ${LAYERDIR}/recipes*/*/*.bbappend"

BBFILE_COLLECTIONS += "meta-mbl-apps"
BBFILE_PATTERN_meta-mbl-apps := "^${LAYERDIR}/"
BBFILE_PRIORITY_meta-mbl-apps = "5"

LAYERSERIES_COMPAT_meta-mbl-apps = "sumo thud warrior"

# meta-mbl-apps inherits classes from "core" (i.e. openembedded-core/meta
# and openembedded-core-mbl/meta). State the dependency here via a dependency
# on openembedded-core-mbl/meta.
LAYERDEPENDS_meta-mbl-apps = "openembedded-core-mbl-meta"

MBL_APPS_LAYER_SCRIPTS = "${LAYERDIR}/scripts"
```

## meta-mbl-bsp-common/conf/layer.conf
```bitbake
# Copyright (c) 2019 Arm Limited and Contributors. All rights reserved.
#
# SPDX-License-Identifier: MIT
#
# mbed linux layer configuration file
BBPATH .= ":${LAYERDIR}"

# We have a recipes directory, add to BBFILES
BBFILES += "${LAYERDIR}/recipes*/*/*.bb ${LAYERDIR}/recipes*/*/*.bbappend"

BBFILE_COLLECTIONS += "meta-mbl-bsp-common"
BBFILE_PATTERN_meta-mbl-bsp-common := "^${LAYERDIR}/"
BBFILE_PRIORITY_meta-mbl-bsp-common = "14"
LAYERSERIES_COMPAT_meta-mbl-bsp-common = "sumo thud warrior"

# Upstream the following fixes for WARNINGS
LAYERSERIES_COMPAT_raspberrypi = "sumo thud warrior"

# meta-mbl-bsp_common depends on "core" (i.e. openembedded-core/meta) for
# a number of reasons:
#   - The layer inherits classes from "core".
#   - ATF support DEPENDS on the u-boot*.bb recipe. 
#   - ATF support DEPENDS on virtual/kernel, for which the provider usually
#     inherits from kernel.bbclass.
LAYERDEPENDS_meta-mbl-bsp-common = "core-mbl"

# meta-mbl-bsp_common ATF support DEPENDS on optee-os recipe
# in meta-linaro*/meta-optee*. 
LAYERDEPENDS_meta-mbl-bsp-common += "meta-optee-mbl"

# This directory is for storing licenses which are not already included in
# openembedded-core/meta/files/common-licenses
LICENSE_PATH += "${LAYERDIR}/files/custom-licenses"
```

## meta-mbl-distro/conf/distro/include/mbl-distro-production.inc
```bitbake
# Copyright (c) 2019 Arm Limited and Contributors. All rights reserved.
#
# SPDX-License-Identifier: MIT

# This file sets default PACKAGECONFIG values for specific packages.
# These values can be used in recipes/classes to take specific actions
# when building its packages.

# In Production images we want the following pakages to be silent
# and don't print any messages into the serial console.

# Possible values for u-boot recipes PACKAGECONFIG:
# "noconsole": disables u-boot console only
# "silent": disables u-boot and kernel consoles
PACKAGECONFIG_append_pn-u-boot-fslc = " silent"
PACKAGECONFIG_append_pn-u-boot-imx = " silent"
PACKAGECONFIG_append_pn-u-boot = " silent"

PACKAGECONFIG_append_pn-atf-${MACHINE} = " silent"
```

## meta-mbl-distro/conf/distro/include/mbl-distro.inc
```bitbake
# Copyright (c) 2018 Arm Limited and Contributors. All rights reserved.
#
# SPDX-License-Identifier: MIT

require conf/distro/mbl-directories.conf
require conf/distro/mbl-linked-repositories.conf

# We don't want to append the libc type into TMPDIR
TCLIBCAPPEND = ""

INHERIT += "mbl-partitions"

DISTRO_NAME = "Mbed Linux OS"
DISTRO_VERSION = "0.0"
DISTRO_FEATURES_append = " virtualization"

# Set systemd as the init manager
DISTRO_FEATURES_append = " systemd"
VIRTUAL-RUNTIME_init_manager = "systemd" 
VIRTUAL-RUNTIME_initscripts = "systemd-compat-units"
DISTRO_FEATURES_BACKFILL_CONSIDERED = "sysvinit"

# We don't want to install avahi-daemon to deal with mDNS.
# We are using systemd-resolved instead
DISTRO_FEATURES_DEFAULT_remove = "zeroconf"

# Enable build history with installed package size information and image info.
INHERIT += "buildhistory"
INHERIT += "image-buildinfo"
BUILDHISTORY_COMMIT = "1"

IMAGE_FSTYPES = "ext4 wic.gz wic.bmap tar.xz"

# Prevent OE from messing around too much with /var/log - we have a separate
# partition for it
VOLATILE_LOG_DIR = "no"

# Remove x11 related packages for distro images.
DISTRO_FEATURES_DEFAULT_remove = "x11"

# dosfstools is in RRECOMMENDS for packagegroup-base-vfat but it's GPLv3 so we
# don't want it
BAD_RECOMMENDATIONS += "dosfstools"

# docker and lxc is in RRECOMMENDS for runc-opencontainers package - we do not need it
# We would like to have the minimal runc functionality
BAD_RECOMMENDATIONS += "docker lxc"

# readline is GPLv3 so don't include the command line tools for bluez5 that
# depend on readline
PACKAGECONFIG_remove_pn-bluez5 = "readline"

# By default wpa-supplicant uses gnutls as its TLS library, but gnutls depends
# on libunistring which is GPLv3, so tell wpa-supplicant to use openssl instead
# of gnutls.
PACKAGECONFIG_pn-wpa-supplicant = "openssl"

# Set runc preferred provider to Open Container Initiative (OCI) runc (default is runc-docker)
PREFERRED_PROVIDER_virtual/runc = "runc-opencontainers"

INITRAMFS_IMAGE = "mbl-image-initramfs"

WKS_FILE = "mbl.wks.in"
```

## meta-mbl-distro/conf/distro/mbl-development.conf
```bitbake
# Copyright (c) 2019 Arm Limited and Contributors. All rights reserved.
#
# SPDX-License-Identifier: MIT

##################################################################################
# mbl-development.conf
#    Based on the main mbl-distro.inc distro level settings
##################################################################################

require conf/distro/include/mbl-distro.inc
```

## meta-mbl-distro/conf/distro/mbl-directories.conf
```bitbake
# Copyright (c) 2018 Arm Limited and Contributors. All rights reserved.
#
# SPDX-License-Identifier: MIT

# This is where boot resources that must be on a file system live. E.g. on
# Raspberry Pi 3 this contains the VC4 firmware and BL2.
#
# WARNING: this directory may not exist on platforms that don't need it!
MBL_BOOTLOADER_FS_DIR = "/bootloaderfs"

# This is where the FIT image containing the currently running kernel lives.
MBL_BOOT_DIR = "/boot"

# This is where flags are kept that indicate which banks of partitions should
# be used.
MBL_BOOTFLAGS_DIR = "/var/log/bootflags"

# This is where configuration set at the factory or at build time is kept
MBL_FACTORY_CONFIG_DIR = "/config/factory"

# This is where configuration set by the user at runtime is kept
MBL_CONFIG_DIR = "/config/user"

# Where logs are kept
MBL_LOG_DIR = "/var/log"

# A directory for temporarily storing large files, e.g. firmware update
# payloads
MBL_SCRATCH_DIR = "/scratch"

# Directory containing apps and per-user data
MBL_HOME_DIR = "/home"

# Path to where apps are installed and run from. This path must reside on a r+w
# partition.
MBL_APP_DIR = "${MBL_HOME_DIR}/app"

# Base directory where PAL (Platform Abstraction Layer) will store the cloud
# certificates
MBL_PAL_BASE_CERT_DIR = "${MBL_CONFIG_DIR}/pal"

# Directory where PAL (Platform Abstraction Layer) will use for firmware update
MBL_PAL_UPDATE_FIRMWARE_DIR = "${MBL_SCRATCH_DIR}/firmware"

# Directory where mbl-cli copies the cloud development certificates
MBL_PROVISIONING_CERT_DIR = "${MBL_SCRATCH_DIR}/provisioning-certs"
```
