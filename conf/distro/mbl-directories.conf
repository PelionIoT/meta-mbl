## conf/machine/raspberrypi3-mbl.conf
```bitbake
# Copyright (c) 2018 Arm Limited and Contributors. All rights reserved.
#
# SPDX-License-Identifier: MIT

#@TYPE: Machine
#@NAME: RaspberryPi 3 Development Board
#@DESCRIPTION: Machine configuration for the RaspberryPi 3 with extra features

MACHINEOVERRIDES =. "raspberrypi3:${MACHINE}:"
include conf/machine/raspberrypi3.conf

# ------------------------------------------------------------------------------
# non-MBL-specific (upstreamable) configuration
# ------------------------------------------------------------------------------


# ------------------------------------------------------------------------------
# MBL-specific (non-upstreamable) configuration
# ------------------------------------------------------------------------------


KERNEL_CLASSES  = "mbl-fitimage"
KERNEL_IMAGETYPE = "fitImage"
KERNEL_DEVICETREE = "bcm2710-rpi-3-b-plus.dtb bcm2710-rpi-3-b.dtb"

##############################################################################
# U-BOOT Symbol Definitions
#
# UBOOT_SIGN_ENABLE
#   This is used to enable u-boot verified boot. See uboot-sign.bbclass for 
#   more information.
##############################################################################
UBOOT_LOADADDRESS = "0x04000000"
UBOOT_MACHINE = "rpi_3_32b_signed_config"
UBOOT_ENTRYPOINT = "0x04000000"
UBOOT_DTB_LOADADDRESS = "0x03000000"
UBOOT_IMAGE = "mbl-u-boot.bin"
UBOOT_SIGN_ENABLE = "1"
RPI_USE_U_BOOT = "1"

WKS_FILE = "mbl-raspberrypi3.wks"

# Tell the meta-raspberrypi layer to send Linux console output to the serial
# console
ENABLE_UART = "1"

# meta-mbl's linux-firmware bbappend (for imx7s-warp-mbl support) conflicts
# with meta-raspberrypi's linux-firmware bbappend (for rpi support). Make sure
# meta-mbl's bbappend doesn't get used for raspberrypi3-mbl
BBMASK += "/meta-mbl/recipes-kernel/linux-firmware/"

# The meta-raspberrypi layer generates a FIT image (boot.scr) using the 
# rpi-u-boot-scr.bb recipe. As MBL meta-mbl generates the FIT image 
# using mbl-fitimage.bbclass, rpi-u-boot-scr.bb is inhibited from running. 
INHERIT += "blacklist"
PNBLACKLIST[rpi-u-boot-scr] = "Do not use rpi-u-boot-scr.bb to generate FIT image."

PREFERRED_PROVIDER_virtual/atf = "atf-rpi3"

# A valid u-boot.bin without any packed data is validated by earlier stage
# bootloader. So include u-boot-nodtb.bin here because u-boot.bin is packed
# with u-boot.dtb.

IMAGE_BOOT_FILES = "bcm2835-bootfiles/* \
                 mbl-bootfiles/* \
                 ${@make_dtb_boot_files(d)} \
                 ${@bb.utils.contains('RPI_USE_U_BOOT', '1', \
                    '${KERNEL_IMAGETYPE} u-boot-nodtb.bin;${SDIMG_KERNELIMAGE}', \
                    '${KERNEL_IMAGETYPE};${SDIMG_KERNELIMAGE}', d)} \
                 "
```

## meta-freescale-3rdparty-mbl/conf/layer.conf
```bitbake
# Copyright (c) 2019 Arm Limited and Contributors. All rights reserved.
#
# SPDX-License-Identifier: MIT
#
# mbed linux layer configuration file
BBPATH .= ":${LAYERDIR}"

# We have a recipes directory, add to BBFILES
BBFILES += "${LAYERDIR}/recipes*/*/*.bb ${LAYERDIR}/recipes*/*/*.bbappend"

BBFILE_COLLECTIONS += "fsl-arm-extra-mbl"
BBFILE_PATTERN_fsl-arm-extra-mbl := "^${LAYERDIR}/"
BBFILE_PRIORITY_fsl-arm-extra-mbl = "6"

LAYERSERIES_COMPAT_fsl-arm-extra-mbl = "sumo thud warrior"
LAYERDEPENDS_fsl-arm-extra-mbl = "fsl-arm-extra"
LAYERDEPENDS_fsl-arm-extra-mbl += "meta-mbl-bsp-common"
```

## meta-freescale-3rdparty-mbl/conf/machine/imx6ul-des0258-mbl.conf
```bitbake
# Copyright (c) 2019 Arm Limited and Contributors. All rights reserved.
#
# SPDX-License-Identifier: MIT

#@TYPE: Machine
#@NAME: IMX6UL DES0258
#@DESCRIPTION: Machine configuration for the IMX6UL DES0258

MACHINEOVERRIDES =. "imx6ul-des0258:${MACHINE}:"

include conf/machine/imx6ulevk.conf
require conf/include/mbl-default.conf

# ------------------------------------------------------------------------------
# non-MBL-specific (upstreamable) configuration
# ------------------------------------------------------------------------------
SERIAL_CONSOLES = "115200;ttymxc0"

# ------------------------------------------------------------------------------
# MBL-specific (non-upstreamable) configuration
# ------------------------------------------------------------------------------


##############################################################################
# KERNEL symbol definitions for virtual/kernel build configuration
#
# PREFERRED_PROVIDER_virtual/kerne"
#   Specify which kernel recipe to use
# KERNEL_CLASSES
#   mbl-fitimage.bbclass is inherited into kernel.bbclass processing by
#   defining this symbol to include mbl-fitimage.
# KERNEL_IMAGETYPE
#   The kernel is packages in a FIT image by specifying "fitImage"
# KERNEL_DEVICETREE
#   Its unnecessary to change this symbol here as the required
#   "imx6l-des0258.dtb" value is specified in imx6l-des0258.conf (included above)
##############################################################################
#KERNEL_CLASSES  = "mbl-fitimage"
PREFERRED_PROVIDER_virtual/kernel = "linux-fslc"
KERNEL_DEVICETREE = "imx6ul-des0258.dtb"
KERNEL_DEFCONFIG = "imx6ul_des0258_defconfig"

INITRAMFS_IMAGE_BUNDLE = "1"
IMAGE_BOOT_FILES += "zImage-initramfs-imx6ul-des0258-mbl.bin"

# Bring in a boot script
MACHINE_EXTRA_RRECOMMENDS_append = "mbl-boot-scr"
IMAGE_BOOT_FILES += "boot.scr"

##############################################################################
# U-BOOT symbol definitions
#
# SPL_BINARY
#   Specify the name of U-boot SPL binary. No SPL is needed if it is empty.
##############################################################################
#SPL_BINARY=""
UBOOT_EXTLINUX = "0"

# WKS_FILES is a priority ordered list of .wks files to look for (see
# image_types_wic.bbclass). The default value of WKS_FILES has ${WKS_FILE}
# listed first so that the user can set the .wks file by setting WKS_FILE.
#
# meta-freescale-3rdparty's imx6l-des0258.conf sets WKS_FILES to
# "imx-uboot-spl.wks", but that prevents specifying the .wks file in WKS_FILE.
# Fix that here re-setting WKS_FILES to list ${WKS_FILE} first. There's not
# much point in us giving imx-uboot-spl.wks as a second item in the list (to
# use as a default .wks file for when WKS_FILE isn't set) because our BSP
# doesn't use SPL.
WKS_FILES = "${WKS_FILE}"

# Remove user-space PCI utils
MACHINE_FEATURES_remove = "pci"

# Specify the ATF recipe to be used for this machine.
PREFERRED_PROVIDER_virtual/atf = "atf-${MACHINE}"

##############################################################################
# Partition layout config
##############################################################################
MBL_WKS_BOOTLOADER1_FILENAME = "SPL"
MBL_WKS_BOOTLOADER1_OFFSET_BANK1_KiB = "1"
MBL_WKS_BOOTLOADER1_SIZE_KiB = "68"
MBL_WKS_BOOTLOADER1_IS_BL2 = "0"

MBL_WKS_BOOTLOADER2_FILENAME = "u-boot.img"
MBL_WKS_BOOTLOADER2_ALIGN_KiB = "1"
MBL_WKS_BOOTLOADER2_OFFSET_BANK1_KiB = "69"
MBL_WKS_BOOTLOADER2_SIZE_KiB = "1024"

# Guess based on value for imx6ul-pico
MBL_FLASH_ERASE_BLOCK_SIZE_KiB = "512"

# Guess based on value for imx6ul-pico
MBL_WKS_STORAGE_SIZE_MiB = "3616"

##############################################################################
# SystemD watchdog config
##############################################################################
# Set the max timeout. The imx series watchdog driver explicitly defines a max
# watchdog timeout of 128 seconds.
MBL_WATCHDOG_TIMEOUT_SECS ?= "128"
# Set the device file name for the hardware watchdog
MBL_WATCHDOG_DEVICE_FILENAME ?= "/dev/watchdog"
```

## meta-freescale-3rdparty-mbl/conf/machine/imx6ul-pico-mbl.conf
```bitbake
# Copyright (c) 2019 Arm Limited and Contributors. All rights reserved.
#
# SPDX-License-Identifier: MIT

#@TYPE: Machine
#@NAME: Technexion IMX6UL PICO-PI Development Board
#@DESCRIPTION: Machine configuration for the PICO PI board

MACHINEOVERRIDES =. "imx6ul-pico:${MACHINE}:"

include conf/machine/imx6ul-pico.conf
require conf/include/mbl-default.conf

# ------------------------------------------------------------------------------
# non-MBL-specific (upstreamable) configuration
# ------------------------------------------------------------------------------
SERIAL_CONSOLES = "115200;ttymxc5"

# ------------------------------------------------------------------------------
# MBL-specific (non-upstreamable) configuration
# ------------------------------------------------------------------------------


##############################################################################
# KERNEL symbol definitions for virtual/kernel build configuration
#
# KERNEL_CLASSES
#   mbl-fitimage.bbclass is inherited into kernel.bbclass processing by
#   defining this symbol to include mbl-fitimage.
# KERNEL_IMAGETYPE
#   The kernel is packages in a FIT image by specifying "fitImage"
# KERNEL_DEVICETREE
#   Its unnecessary to change this symbol here as the required
#   "imx6l-pico.dtb" value is specified in imx6l-pico.conf (included above)
##############################################################################
KERNEL_CLASSES  = "mbl-fitimage"
KERNEL_DEVICETREE = "imx6ul-pico-pi.dtb"
KERNEL_IMAGETYPE = "fitImage"

#INITRAMFS_IMAGE_BUNDLE = "1"
#IMAGE_BOOT_FILES += "zImage-initramfs-imx6ul-pico-mbl.bin"

# Bring in a boot script
#MACHINE_EXTRA_RRECOMMENDS_append = "mbl-boot-scr"
#IMAGE_BOOT_FILES += "boot.scr"

##############################################################################
# U-BOOT symbol definitions
#
# SPL_BINARY
#   Specify the name of U-boot SPL binary. No SPL is needed if it is empty.
##############################################################################
SPL_BINARY=""
UBOOT_EXTLINUX = "0"
UBOOT_CONFIG = ""
UBOOT_MACHINE = "pico-imx6ul_bl33_defconfig"
UBOOT_SUFFIX = "bin"
UBOOT_BINARY = "u-boot.${UBOOT_SUFFIX}"
UBOOT_ENTRYPOINT = "0x87800000"
UBOOT_DTB_LOADADDRESS = "0x83000000"
# Availabe memory for ramdisk: 0x87900000 - 0x9DFFFFFF
# as setup in atf, after BL33/U-BOOT allocated memory area
UBOOT_RD_LOADADDRESS = "0x87900000"
UBOOT_RD_ENTRYPOINT = "0x87900000"
UBOOT_IMAGE = "mbl-u-boot.bin"
UBOOT_SIGN_ENABLE = "1"

# WKS_FILES is a priority ordered list of .wks files to look for (see
# image_types_wic.bbclass). The default value of WKS_FILES has ${WKS_FILE}
# listed first so that the user can set the .wks file by setting WKS_FILE.
#
# meta-freescale-3rdparty's imx6l-pico.conf sets WKS_FILES to
# "imx-uboot-spl.wks", but that prevents specifying the .wks file in WKS_FILE.
# Fix that here re-setting WKS_FILES to list ${WKS_FILE} first. There's not
# much point in us giving imx-uboot-spl.wks as a second item in the list (to
# use as a default .wks file for when WKS_FILE isn't set) because our BSP
# doesn't use SPL.
WKS_FILES = "${WKS_FILE}"

# Remove all recipes except kernel modules recipe in fsl-bsp-release
BBMASK += "/meta-fsl-bsp-release/imx/meta-bsp/classes/"
BBMASK += "/meta-fsl-bsp-release/imx/meta-bsp/recipes-browser/"
BBMASK += "/meta-fsl-bsp-release/imx/meta-bsp/recipes-connectivity/"
BBMASK += "/meta-fsl-bsp-release/imx/meta-bsp/recipes-core/"
BBMASK += "/meta-fsl-bsp-release/imx/meta-bsp/recipes-devtools/"
BBMASK += "/meta-fsl-bsp-release/imx/meta-bsp/recipes-graphics/"
BBMASK += "/meta-fsl-bsp-release/imx/meta-bsp/recipes-multimedia/"
BBMASK += "/meta-fsl-bsp-release/imx/meta-bsp/recipes-security/"
BBMASK += "/meta-fsl-bsp-release/imx/meta-bsp/recipes-utils/"
BBMASK += "/meta-fsl-bsp-release/imx/meta-bsp/recipes-kernel/linux/"
BBMASK += "/meta-fsl-bsp-release/imx/meta-bsp/recipes-kernel/linux-firmware/"
BBMASK += "/meta-fsl-bsp-release/imx/meta-bsp/recipes-kernel/kernel-modules/kernel-module-imx-gpu-viv*.bb"

# Because of license restrictions we want to use fsl-eula-unpack.bbclass from
# meta-fsl-bsp-release instead the one provided by meta-freescale.
# Also mask firmware-imx in meta-fsl-bsp-release-mbl to avoid missing
# target file error for bbappend file.
BBMASK += "/meta-fsl-bsp-release/imx/meta-bsp/recipes-bsp/(?!firmware-qca)"
BBMASK += "/meta-fsl-bsp-release/imx/meta-bsp/classes/(?!fsl-eula-unpack\.bbclass)"
BBMASK += "/meta-freescale/classes/fsl-eula-unpack.bbclass"
BBMASK += "/meta-mbl/meta-fsl-bsp-release-mbl/imx/meta-bsp/recipes-bsp/firmware-imx/"

# We need to set the EULA file from meta-fsl-bsp-release instead of
# meta-freescale/EULA
FSL_EULA_FILE = "${OEROOT}/layers/meta-fsl-bsp-release/imx/EULA.txt"

# Specify the ATF recipe to be used for this machine.
PREFERRED_PROVIDER_virtual/atf = "atf-${MACHINE}"

# Don't use any of the firmware-imx-* packages - they're covered by a EULA that
# prevents us doing binary releases
MACHINE_EXTRA_RRECOMMENDS_remove = "firmware-imx-vpu-imx6d"
MACHINE_EXTRA_RRECOMMENDS_remove = "firmware-imx-vpu-imx6q"

# Specify qca9377 firmware binary to be released with this machine, otherwise
# only script is released to download binary on the board later.
MACHINE_FEATURES += "qca9377-bin"

# Add in WiFi driver and firmware from meta-freescale-bsp-release
MACHINE_EXTRA_RRECOMMENDS_append = " kernel-module-qca9377 "
MACHINE_EXTRA_RRECOMMENDS_append = " \
    ${@bb.utils.contains('MACHINE_FEATURES', 'qca9377-bin', 'firmware-qca9377', 'kernel-module-qca9377-firmware-tools', d)} \
"

# The name of the usbgadget ethernet interface to be used for debugging
MBL_DBG_IFNAME = "usbdbg0"

##############################################################################
# Partition layout config
##############################################################################
MBL_WKS_BOOTLOADER1_FILENAME = "bl2.bin.imx"
MBL_WKS_BOOTLOADER1_OFFSET_BANK1_KiB = "1"
MBL_WKS_BOOTLOADER1_SIZE_KiB = "1023"
MBL_WKS_BOOTLOADER1_IS_BL2 = "1"

MBL_WKS_BOOTLOADER2_SIZE_KiB = "1024"
MBL_WKS_BOOTLOADER2_IS_BL3 = "1"

# As reported by "mmc extcsd read /dev/mmcblk0"
MBL_FLASH_ERASE_BLOCK_SIZE_KiB = "512"

# "blockdev --getsize64 /dev/mmcblk0" reports 3791650816B (= 3616MiB)
MBL_WKS_STORAGE_SIZE_MiB = "3616"

##############################################################################
# SystemD watchdog config
##############################################################################
# Set the max timeout. The imx series watchdog driver explicitly defines a max
# watchdog timeout of 128 seconds.
MBL_WATCHDOG_TIMEOUT_SECS ?= "128"
# Set the device file name for the hardware watchdog
MBL_WATCHDOG_DEVICE_FILENAME ?= "/dev/watchdog"
```
