## meta-mbl-distro/conf/distro/mbl-linked-repositories.conf
```bitbake
# Copyright (c) 2019 Arm Limited and Contributors. All rights reserved.
#
# SPDX-License-Identifier: MIT

###############################################################################
#   This file configures internally-linked repositories variables, to uniformaly be used by the fetcher across all managed repositories.
#   Each linked repository has 2 variables - SRC_URI_<repo name>_REPO and SRCREV_<repo name>.
#   Usr may add (or override) additional options from the bitbake source file, by using a 3rd variable SRC_URI_OPTIONS_<repo name>_REPO.
#   Whenever SRCREV is hard coded in this file, we wanted the same SRCREV to be uniformaly fetched by all recipes.
#   Here are some comments on the branch and source revision configuration :
#   1) Do not give a branch name and leave SRCREV empty ("") to get the master branch.
#   2) Give a branch name and leave SRCREV empty ("") to get another branch than master.
#)  3) To choose a specific revision and ignoring any branch - add nobranch=1 in the SRC_URI and state the revision hash.
#   4) To choose a specific revision on a branch (not necessarily on the head) - give both branch name and revision hash.
#      Fetcher will validate that revision is on the branch (this is less error prune).
###############################################################################

SRC_URI_OPTIONS_MBL_CORE_REPO ??= ""
SRC_URI_MBL_CORE_REPO = "git://git@github.com/ARMmbed/mbl-core.git;protocol=ssh;nobranch=1;${SRC_URI_OPTIONS_MBL_CORE_REPO};"
SRCREV_MBL_CORE_REPO = "20a30d3c52103bfcf90f4708674ce4a60366188a"

SRC_URI_OPTIONS_MBL_CLOUD_CLIENT_INTERNAL_REPO ??= ""
SRC_URI_MBL_CLOUD_CLIENT_INTERNAL_REPO = "\
    git://git@github.com/ARMmbed/mbl-cloud-client-internal.git;nobranch=1;protocol=ssh;${SRC_URI_OPTIONS_MBL_CLOUD_CLIENT_INTERNAL_REPO};"
SRCREV_MBL_CLOUD_CLIENT_INTERNAL_REPO = "ed5d641571c25df6f924739a58be64cee9885520"

SRC_URI_OPTIONS_MBL_SCRATCH_REPO ??= ""
SRC_URI_MBL_SCRATCH_REPO = "git://git@github.com/ARMmbed/mbl-scratch.git;protocol=ssh;${SRC_URI_OPTIONS_MBL_SCRATCH_REPO};"

SRC_URI_OPTIONS_MBL_OPTEE_REFERENCE_APPS_REPO ??= ""
SRC_URI_MBL_OPTEE_REFERENCE_APPS_REPO = " \
    git://git@github.com/ARMmbed/mbl-optee-reference-apps.git;nobranch=1;protocol=ssh;${SRC_URI_OPTIONS_MBL_OPTEE_REFERENCE_APPS_REPO};"
SRCREV_MBL_OPTEE_REFERENCE_APPS_REPO = "92ddf857cd0bd3ca2ee2cf355798332c2038053f"
```

## meta-mbl-distro/conf/distro/mbl-production.conf
```bitbake
# Copyright (c) 2019 Arm Limited and Contributors. All rights reserved.
#
# SPDX-License-Identifier: MIT

##################################################################################
# mbl-production.conf
#    Based on the main mbl.conf distribution
#    Sets some defaults PACKAGECONFIGS options via mbl-distro-production.inc
##################################################################################

require conf/distro/mbl.conf
require conf/distro/include/mbl-distro-production.inc
```

## meta-mbl-distro/conf/distro/mbl.conf
```bitbake
# Copyright (c) 2018 Arm Limited and Contributors. All rights reserved.
#
# SPDX-License-Identifier: MIT

###############################################################################
# mbl.conf
#
# This file is the mbed linux OpenEmbedded distribution configuration file.
# The symbol definitions control the behaviour of the meta layers composed
# to form the distribution, including:
# - Enabling the distribution virtualisation features.
# - Removing the x11 feature which is enabled by default.
# - Specifying virtual providers for subsystems.
###############################################################################

require conf/distro/mbl-partitions.conf
require conf/distro/mbl-directories.conf
require conf/distro/mbl-linked-repositories.conf
require conf/distro/include/mbl-default.conf

DISTRO_NAME = "Mbed Linux OS"
DISTRO_VERSION = "0.0"
DISTRO_FEATURES_append = " virtualization"

# Set systemd as the init manager
DISTRO_FEATURES_append = " systemd"
VIRTUAL-RUNTIME_init_manager = "systemd" 
VIRTUAL-RUNTIME_initscripts = "systemd-compat-units"
DISTRO_FEATURES_BACKFILL_CONSIDERED = "sysvinit"

# Enable build history with installed package size information and image info.
INHERIT += "buildhistory"
INHERIT += "image-buildinfo"
BUILDHISTORY_COMMIT = "1"

IMAGE_FSTYPES = "ext4 wic.gz wic.bmap tar.xz"

# See MBL_FIT_IMAGE_BOOT_FILES_DIR comments in mbl-default.conf for more
# details.
IMAGE_BOOT_FILES += "${MBL_FIT_IMAGE_BOOT_FILES_DIR}/*"

# Prevent OE from messing around too much with /var/log - we have a separate
# partition for it
VOLATILE_LOG_DIR = "no"

# Remove x11 related packages for distro images.
DISTRO_FEATURES_DEFAULT_remove = "x11"

# dosfstools is in RRECOMMENDS for packagegroup-base-vfat but it's GPLv3 so we
# don't want it
BAD_RECOMMENDATIONS += "dosfstools"

# docker and lxc is in RRECOMMENDS for runc-opencontainers package - we do not need it
# We would like to have the minimal runc functionality
BAD_RECOMMENDATIONS += "docker lxc"

# readline is GPLv3 so don't include the command line tools for bluez5 that
# depend on readline
PACKAGECONFIG_remove_pn-bluez5 = "readline"

# By default wpa-supplicant uses gnutls as its TLS library, but gnutls depends
# on libunistring which is GPLv3, so tell wpa-supplicant to use openssl instead
# of gnutls.
PACKAGECONFIG_pn-wpa-supplicant = "openssl"

# Defines root hash suffix.
ROOT_HASH_SUFFIX  = ".root_hash.txt"
#
# Defines signed root hash suffix.
SIGNED_ROOT_HASH_SUFFIX = ".sha256"
#
# Defines base 64 suffix used for the signed root hash
BASE64_SUFFIX = ".base64"
#
# Defines directory for the Verity keys
VERITY_KEYS_DIR = "${MBL_DISTRO_LAYER_VERITY_KEYS_DIR}"

# Defines rootfs verity public key name
VERITY_ROOTFS_ROOT_HASH_PUBLIC_KEY_NAME="verity_rootfs_root_hash_public.pem"
#
# Defines rootfs verity private key name
VERITY_ROOTFS_ROOT_HASH_PRIVATE_KEY_NAME="verity_rootfs_root_hash_private.pem"

# Set runc preferred provider to Open Container Initiative (OCI) runc (default is runc-docker)
PREFERRED_PROVIDER_virtual/runc = "runc-opencontainers"
```

## meta-mbl-distro/conf/layer.conf
```bitbake
# Copyright (c) 2018 Arm Limited and Contributors. All rights reserved.
#
# SPDX-License-Identifier: MIT
#
# meta-mbl-distro layer configuration file
BBPATH .= ":${LAYERDIR}"

# We have a recipes directory, add to BBFILES
BBFILES += "${LAYERDIR}/recipes*/*/*.bb ${LAYERDIR}/recipes*/*/*.bbappend"

BBFILE_COLLECTIONS += "meta-mbl-distro"
BBFILE_PATTERN_meta-mbl-distro := "^${LAYERDIR}/"
LAYERSERIES_COMPAT_meta-mbl-distro = "warrior zeus"

LAYERDEPENDS_meta-mbl-distro = "meta-mbl-apps"
LAYERDEPENDS_meta-mbl-distro += "virtualization-layer-mbl"
```

## meta-openembedded-mbl/meta-oe-mbl/conf/layer.conf
```bitbake
# Copyright (c) 2018 Arm Limited and Contributors. All rights reserved.
#
# SPDX-License-Identifier: MIT

# mbed linux layer configuration file
BBPATH .= ":${LAYERDIR}"

# We have a recipes directory, add to BBFILES
BBFILES += "${LAYERDIR}/recipes*/*/*.bb ${LAYERDIR}/recipes*/*/*.bbappend"

BBFILE_COLLECTIONS += "meta-oe-mbl"
BBFILE_PATTERN_meta-oe-mbl := "^${LAYERDIR}/"
BBFILE_PRIORITY_meta-oe-mbl = "7"
LAYERSERIES_COMPAT_meta-oe-mbl = "sumo thud warrior"
```

## meta-psa/conf/layer.conf
```bitbake
# Copyright (c) 2019 Arm Limited and Contributors. All rights reserved.
#
# SPDX-License-Identifier: MIT
#
# meta-psa layer configuration file
BBPATH .= ":${LAYERDIR}"

# We have a recipes directory, add to BBFILES
BBFILES += "${LAYERDIR}/recipes*/*/*.bb ${LAYERDIR}/recipes*/*/*.bbappend"

BBFILE_COLLECTIONS += "meta-psa"
BBFILE_PATTERN_meta-psa := "^${LAYERDIR}/"

LAYERSERIES_COMPAT_meta-psa = "warrior"
LAYERDEPENDS_meta-psa = "core"
LAYERDEPENDS_meta-psa += "security"
```

## meta-raspberrypi-mbl/conf/layer.conf
```bitbake
# Copyright (c) 2019 Arm Limited and Contributors. All rights reserved.
#
# SPDX-License-Identifier: MIT
#
# mbed linux layer configuration file
BBPATH .= ":${LAYERDIR}"

# We have a recipes directory, add to BBFILES
BBFILES += "${LAYERDIR}/recipes*/*/*.bb ${LAYERDIR}/recipes*/*/*.bbappend"

BBFILE_COLLECTIONS += "raspberrypi-mbl"
BBFILE_PATTERN_raspberrypi-mbl := "^${LAYERDIR}/"

LAYERSERIES_COMPAT_raspberrypi-mbl = "warrior"
LAYERDEPENDS_raspberrypi-mbl = "raspberrypi"
LAYERDEPENDS_raspberrypi-mbl += "meta-mbl-bsp-common"

# This directory is for storing licenses which are not already included in
# openembedded-core/meta/files/common-licenses
LICENSE_PATH += "${LAYERDIR}/files/custom-licenses"
```

## meta-raspberrypi-mbl/conf/machine/raspberrypi3-mbl.conf
```bitbake
# Copyright (c) 2018 Arm Limited and Contributors. All rights reserved.
#
# SPDX-License-Identifier: MIT

#@TYPE: Machine
#@NAME: RaspberryPi 3 Development Board
#@DESCRIPTION: Machine configuration for the RaspberryPi 3 with extra features

MACHINEOVERRIDES =. "raspberrypi3:${MACHINE}:"
include conf/machine/raspberrypi3.conf

# The IMAGE_BOOT_FILES settings from meta-raspberrypi's config files is not
# suitable for us so clear it after including raspberrypi3.conf and let our
# conf files start again from scratch. This must be done before including
# "mbl-default.conf" because that conf file adds things to IMAGE_BOOT_FILES
# that we actually want.
IMAGE_BOOT_FILES = ""

require conf/include/mbl-default.conf

# ------------------------------------------------------------------------------
# non-MBL-specific (upstreamable) configuration
# ------------------------------------------------------------------------------


# ------------------------------------------------------------------------------
# MBL-specific (non-upstreamable) configuration
# ------------------------------------------------------------------------------


##############################################################################
# KERNEL symbol definitions for virtual/kernel build configuration
#
# KERNEL_CLASSES
#   mbl-fitimage.bbclass is inherited into kernel.bbclass processing by
#   defining this symbol to include mbl-fitimage.
# KERNEL_IMAGETYPE
#   The kernel is packages in a FIT image by specifying "fitImage"
# KERNEL_DEVICETREE
#   Specify the devices tree's to be includes in the FIT image.
##############################################################################
KERNEL_CLASSES  = "mbl-fitimage"
KERNEL_IMAGETYPE = "fitImage"
KERNEL_DEVICETREE = "bcm2710-rpi-3-b-plus.dtb bcm2710-rpi-3-b.dtb"

##############################################################################
# U-BOOT Symbol Definitions
#
# UBOOT_SIGN_ENABLE
#   This is used to enable u-boot verified boot. See uboot-sign.bbclass for
#   more information.
##############################################################################
UBOOT_MACHINE = "rpi_3_32b_defconfig"
UBOOT_ENTRYPOINT = "0x04000000"
UBOOT_DTB_LOADADDRESS = "0x03000000"
UBOOT_IMAGE = "mbl-u-boot.bin"
UBOOT_SIGN_ENABLE = "1"
RPI_USE_U_BOOT = "1"

# Tell the meta-raspberrypi layer to send Linux console output to the serial
# console
ENABLE_UART = "1"

# The meta-raspberrypi layer generates a FIT image (boot.scr) using the
# rpi-u-boot-scr.bb recipe. As MBL meta-mbl generates the FIT image
# using mbl-fitimage.bbclass, rpi-u-boot-scr.bb is inhibited from running.
INHERIT += "blacklist"
PNBLACKLIST[rpi-u-boot-scr] = "Do not use rpi-u-boot-scr.bb to generate FIT image."

# Specify the ATF recipe to be used for this machine.
PREFERRED_PROVIDER_virtual/atf = "atf-${MACHINE}"

# rpi3-extra-dtb-overlay package - add manually created dtb overlay
MACHINE_EXTRA_RRECOMMENDS += " rpi3-extra-dtb-overlay "

# A valid u-boot.bin without any packed data is validated by earlier stage
# bootloader. So include u-boot-nodtb.bin here because u-boot.bin is packed
# with u-boot.dtb.

IMAGE_BOOT_FILES += "bcm2835-bootfiles/* \
                 ${@make_dtb_boot_files(d)} \
                 ${@bb.utils.contains('RPI_USE_U_BOOT', '1', \
                    '${KERNEL_IMAGETYPE} u-boot-nodtb.bin;${SDIMG_KERNELIMAGE}', \
                    '${KERNEL_IMAGETYPE};${SDIMG_KERNELIMAGE}', d)} \
                 "

# The name of the ethernet interface to be used for debugging
MBL_DBG_IFNAME = "eth1"

##############################################################################
# Partition layout config
##############################################################################
# BL2 is stored in a FAT partition on rpi3, not in an area of raw storage
MBL_WKS_BOOTLOADER1_SKIP = "1"

MBL_WKS_BOOTLOADER2_FILENAME = "fip2.bin"
MBL_WKS_BOOTLOADER2_IS_BL3 = "1"

MBL_WKS_BOOTLOADER_FS_SKIP = "0"

# We assume an 8GB or larger SD Card. 8GB =~ 7.4GiB. Round down to 7GiB to be
# on the safe side.
#
# Override this variable in local.conf if you use a different size of SD Card.
MBL_WKS_STORAGE_SIZE_MiB ?= "7168"

##############################################################################
# SystemD watchdog config
##############################################################################
# Set the max timeout for RPI3. The RPI watchdog hardware has a max timeout of
# 15 seconds.
MBL_WATCHDOG_TIMEOUT_SECS ?= "15"
# Set the device file name for the hardware watchdog
MBL_WATCHDOG_DEVICE_FILENAME ?= "/dev/watchdog"
```

## meta-virtualization-mbl/conf/layer.conf
```bitbake
# Copyright (c) 2019 Arm Limited and Contributors. All rights reserved.
#
# SPDX-License-Identifier: MIT
#
# mbed linux layer configuration file
BBPATH .= ":${LAYERDIR}"

# We have a recipes directory, add to BBFILES
BBFILES += "${LAYERDIR}/recipes*/*/*.bb ${LAYERDIR}/recipes*/*/*.bbappend"

BBFILE_COLLECTIONS += "virtualization-layer-mbl"
BBFILE_PATTERN_virtualization-layer-mbl := "^${LAYERDIR}/"
BBFILE_PRIORITY_virtualization-layer-mbl = "5"

LAYERSERIES_COMPAT_virtualization-layer-mbl = "warrior"
LAYERDEPENDS_virtualization-layer-mbl = "virtualization-layer"
```

## openembedded-core-mbl/meta/conf/layer.conf
```bitbake
# Copyright (c) 2019 Arm Limited and Contributors. All rights reserved.
#
# SPDX-License-Identifier: MIT
#
# mbed linux layer configuration file
BBPATH .= ":${LAYERDIR}"

# We have a recipes directory, add to BBFILES
BBFILES += "${LAYERDIR}/recipes*/*/*.bb ${LAYERDIR}/recipes*/*/*.bbappend"

BBFILE_COLLECTIONS += "core-mbl"
BBFILE_PATTERN_core-mbl := "^${LAYERDIR}/"
BBFILE_PRIORITY_core-mbl = "8"

LAYERSERIES_COMPAT_core-mbl = "thud warrior"
LAYERDEPENDS_core-mbl = "core"
```

## recipes-bsp/mbl-boot-scr/files/bananapi-zero/boot.its
```
/*
 * Copyright (C) 2017 Linaro Ltd.
 *
 * Minimal dts for a boot.scr image payload.
 *
 * SPDX-License-Identifier: GPL-2.0+  X11
 */

/dts-v1/;

/ {
	description = "FIT image boot.scr";
	#address-cells = <1>;

	images {
		bootscr {
			description = "boot.scr";
			data = /incbin/("boot.cmd");
			type = "script";
			arch = "standalone";
			compression = "none";
			hash@1 {
				algo = "sha1";
			};
			signature@1 {
				algo = "sha1,rsa2048";
				key-name-hint = "dev";
			};
		};
	};

	configurations {
		default = "conf@1";
		conf@1 {
			description = "bananapi-m2-zero-scr";
			loadables = "bootscr";
			signature@1 {
				algo = "sha1,rsa2048";
				key-name-hint = "dev";
				sign-images = "loadables";
			};
		};
	};
};
```
